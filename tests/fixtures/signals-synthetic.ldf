/* Synthetic LIN fixture. No real nodes or hardware have been measured. */
LIN_description_file;
LIN_protocol_version = "2.2";
LIN_language_version = "2.2";
LIN_speed = 19.2 kbps;
Nodes {
    Master: Tester, 5 ms, 0.1 ms;
    Slaves: Sensor, Actuator;
}
Signals {
    Command: 3, 2, Tester, Sensor, Actuator;
    Position: 12, 16, Sensor, Tester;
    Status: 8, 5, Sensor, Tester;
    Bytes: 16, {0x12, 0x34}, Actuator, Tester;
}
Frames {
    Control: 0x10, Tester, 2 { Command, 0; }
    Measurement: 0x11, Sensor, 2 { Position, 0; }
    State: 0x12, Sensor, 1 { Status, 0; }
    Blob: 0x13, Actuator, 3 { Bytes, 0; }
}
Node_attributes {
    Sensor { LIN_protocol = "2.2"; configured_NAD = 1; product_id = 1, 2, 3; response_error = Status; configurable_frames { Measurement; State; } }
    Actuator { LIN_protocol = "1.3"; configured_NAD = 2; product_id = 1, 3, 4; configurable_frames { Blob; } }
}
Schedule_tables {
    Main { Control delay 10 ms; Measurement delay 10 ms; }
    Alternate { State delay 10 ms; Blob delay 10 ms; Control delay 10 ms; }
    Fractional { Measurement delay 10.5 ms; }
    DiagnosticOnly { MasterReq delay 10 ms; }
}
Signal_encoding_types {
    Mode { logical_value, 0, "Off"; logical_value, 2, "On"; }
    Segments { physical_value, 0, 100, 0.1, 0, "mm"; physical_value, 101, 200, 0.1, -10, "mm"; }
}
Signal_representation { Mode: Command; Segments: Position; }
